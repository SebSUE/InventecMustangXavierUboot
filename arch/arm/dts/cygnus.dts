/*
 * Copyright (C) 2015 Broadcom Incorporated - http://www.broadcom.com/
 *
 * This program is free software; you can redistribute it and/or modify
 * it under the terms of the GNU General Public License version 2 as
 * published by the Free Software Foundation.
 */

/dts-v1/;

#include "skeleton.dtsi"

/ {
	model = "Cygnus generic board";
	compatible = "cygnus";
};
