## configs/bcm11130_defconfig
```kconfig
CONFIG_SYS_EXTRA_OPTIONS="CMD_EMMC,SYS_MMC_ENV_DEV=0"
CONFIG_ARM=y
CONFIG_TARGET_BCM28155_AP=y
```

## configs/bcm11130_nand_defconfig
```kconfig
CONFIG_SYS_EXTRA_OPTIONS="NAND,NAND_SAMSUNG_K9F2G08U0C"
CONFIG_ARM=y
CONFIG_TARGET_BCM28155_AP=y
```

## configs/bcm911360_entphn-emmc_defconfig
```kconfig
CONFIG_SYS_EXTRA_OPTIONS="SYS_SDRAM_SIZE=0x20000000,LCD,WINTEK_640480,DIAGS_NUM_MMC_PORTS=1,LCD,WINTEK_640480,DIAGS_UART_BITS=0x8,DIAGS_I2C_SLAVE_ADDR=0x4A,DIAGS_PWM=0,DIAGS_KEYPAD=0x0505,DIAGS_SPI=0x0,ENV_IS_IN_MMC"
CONFIG_ARM=y
CONFIG_TARGET_BCMCYGNUS=y
CONFIG_DEFAULT_DEVICE_TREE="cygnus"
```

## configs/bcm911360_entphn-ns_defconfig
```kconfig
CONFIG_SYS_EXTRA_OPTIONS="SYS_SDRAM_SIZE=0x20000000,RESERVE_SECSTOR_PARTITION"
CONFIG_ARM=y
CONFIG_TARGET_BCMCYGNUS=y
CONFIG_DEFAULT_DEVICE_TREE="cygnus"
```

## configs/bcm958300k-ns_defconfig
```kconfig
CONFIG_SYS_EXTRA_OPTIONS="SYS_SDRAM_SIZE=0x40000000,BCM_ETH_LANESWAP,LCD,NHD_800480TF,RESERVE_SECSTOR_PARTITION"
CONFIG_ARM=y
CONFIG_TARGET_BCMCYGNUS=y
CONFIG_DEFAULT_DEVICE_TREE="cygnus"
```

## configs/bcm958305_dnle2_defconfig
```kconfig
CONFIG_SYS_EXTRA_OPTIONS="SYS_SDRAM_SIZE=0x10000000,BCM_NAND_SS_K9F4G08U0E,BCM_ETH_0_100MB,LCD,APTUS,DIAGS_SPI=0x0001"
CONFIG_ARM=y
CONFIG_TARGET_BCMCYGNUS=y
CONFIG_DEFAULT_DEVICE_TREE="cygnus"
```

## configs/bcm958305k_defconfig
```kconfig
CONFIG_SYS_EXTRA_OPTIONS="SYS_SDRAM_SIZE=0x20000000,DIAGS_NUM_MMC_PORTS=1,DIAGS_UART_BITS=0xB,DIAGS_PWM=3,DIAGS_SPI=0x0111"
CONFIG_ARM=y
CONFIG_TARGET_BCMCYGNUS=y
CONFIG_DEFAULT_DEVICE_TREE="cygnus"
```

## configs/leafdmic_defconfig
```kconfig
CONFIG_SYS_EXTRA_OPTIONS="SYS_SDRAM_SIZE=0x01000000"
CONFIG_ARM=y
CONFIG_TARGET_BCMCYGNUS=y
CONFIG_DEFAULT_DEVICE_TREE="sandbox"
```

## configs/we3_defconfig
```kconfig
CONFIG_SYS_EXTRA_OPTIONS="SYS_SDRAM_SIZE=0x10000000,DIAGS_NUM_MMC_PORTS=1,DIAGS_UART_BITS=0x8,DIAGS_I2C_SLAVE_ADDR=0x4A,DIAGS_PWM=0,DIAGS_KEYPAD=0x0505,DIAGS_SPI=0x0"
CONFIG_ARM=y
CONFIG_TARGET_BCMCYGNUS=y
CONFIG_DEFAULT_DEVICE_TREE="cygnus"
```
